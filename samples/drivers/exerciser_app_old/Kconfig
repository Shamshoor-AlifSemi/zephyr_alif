## samples/drivers/exerciser_app_old/Kconfig
```kconfig
# Copyright (c) 2023 Nordic Semiconductor ASA
# Copyright (c) 2023 Antmicro <www.antmicro.com>
# SPDX-License-Identifier: Apache-2.0

# Source common USB sample options used to initialize new experimental USB
# device stack. The scope of these options is limited to USB samples in project
# tree, you cannot use them in your own application.
mainmenu "Filesystems Sample Application"

config FS_SAMPLE_CREATE_SOME_ENTRIES
        bool "When no files are found on mounted partition create some"
        default y
        help
          In case when no files could be listed, because there are none,
          "some.dir" directory and "other.txt" file will be created
          and list will run again to show them. This is useful when
          showing how file system works on non-SD devices like internal
          flash or (Q)SPI connected memories, where it is not possible to
          easily add files with use of other device.

#config I2C
#        default $(dt_compat_on_bus,$(DT_COMPAT_WOLFSON_WM8731),i2c)

#source "samples/subsys/usb/common/Kconfig.sample_usbd"
source "Kconfig.zephyr"
```

## samples/drivers/i2s/i2s_codec/boards/alif_b1_dk_ab1c1f4m51820ph0_rtss_he.conf
```kconfig
#
# Copyright 2024 AlifSemiconductor
#
# SPDX-License-Identifier: Apache-2.0
#

CONFIG_I2C=y
CONFIG_HEAP_MEM_POOL_SIZE=81920
CONFIG_AUDIO=y
CONFIG_AUDIO_CODEC=y
CONFIG_AUDIO_CODEC_WM8904=y
CONFIG_SAMPLE_FREQ=48000
```
